## UltraNodeV5/main/Kconfig.projbuild
```kconfig
menu "UltraLights Configuration"

menu "System"
    config UL_IS_ESP32C3
        bool "Target is ESP32-C3"
        default n

    config UL_HAS_PSRAM
        bool "External PSRAM available"
        default y if SPIRAM
        help
            Enable features that require off-chip PSRAM such as high-memory WS2812 effects.
endmenu

menu "Node / Network"
    config UL_NODE_ID
        string "Node ID"
        default "node01"
    config UL_WIFI_STATIC_CREDENTIALS
        bool "Provide built-in Wi-Fi credentials"
        default n
        help
            When enabled, the node will seed its credential store with the
            SSID/password defined below. Disable this when using the captive
            portal provisioning flow so the firmware starts without preloaded
            credentials.
    if UL_WIFI_STATIC_CREDENTIALS
        config UL_WIFI_SSID
            string "Wi-Fi SSID"
        config UL_WIFI_PSK
            string "Wi-Fi password"
    endif
    config UL_WIFI_RESET_BUTTON_ENABLE
        bool "Enable boot button Wi-Fi reset"
        default y
        help
            When enabled, the ESP32 boot button (or the configured GPIO) is
            monitored during runtime. Holding it low for the configured
            duration clears the stored Wi-Fi credentials and reboots the node
            so it re-enters provisioning mode.
    if UL_WIFI_RESET_BUTTON_ENABLE
        config UL_WIFI_RESET_BUTTON_GPIO
            int "Wi-Fi reset button GPIO"
            range 0 48
            default 0
        config UL_WIFI_RESET_BUTTON_HOLD_MS
            int "Wi-Fi reset hold time (ms)"
            range 1000 60000
            default 5000
        config UL_WIFI_RESET_BUTTON_POLL_MS
            int "Wi-Fi reset button poll interval (ms)"
            range 10 1000
            default 50
    endif
    config UL_SNTP_SYNC_INTERVAL_S
        int "SNTP sync interval (seconds)"
        range 60 86400
        default 21600
    config UL_TIMEZONE
        string "Time zone (TZ string)"
        default ""
        help
            POSIX TZ string (e.g., "PST8PDT,M3.2.0/2,M11.1.0/2"). If left empty, UTC is used.
endmenu

menu "MQTT"
    config UL_MQTT_URI
        string "MQTT URI"
        default "mqtts://lights.evm100.org:8883"
    config UL_MQTT_USER
        string "MQTT Username"
        default "uluser"
    config UL_MQTT_PASS
        string "MQTT Password"
        default "ulpwd"
    config UL_MQTT_DIAL_HOST
        string "Override MQTT dial host/IP"
        default ""
        help
            If set, connections to the MQTT broker will be made using this host or
            IP address instead of the hostname in UL_MQTT_URI. TLS verification still
            uses UL_MQTT_TLS_COMMON_NAME so certificates can be validated while
            dialing a local address (e.g., when the broker is on the LAN).
    config UL_MQTT_DIAL_PORT
        int "Override MQTT dial port"
        range 0 65535
        default 0
        help
            Optional TCP port used with UL_MQTT_DIAL_HOST. Leave as 0 to reuse the
            port from UL_MQTT_URI. Set a non-zero value to explicitly choose the
            listening port when overriding the dial host.
    config UL_MQTT_USE_TLS
        bool "Use TLS for MQTT"
        default y
        help
            Enable TLS when connecting to the MQTT broker.
    if UL_MQTT_USE_TLS
        config UL_MQTT_TLS_COMMON_NAME
            string "MQTT TLS common name"
            default "lights.evm100.org"
            help
                Expected common name (CN) presented by the MQTT broker's TLS certificate.
        config UL_MQTT_TLS_SKIP_COMMON_NAME_CHECK
            bool "Skip MQTT TLS common name check"
            default n
            help
                Disable certificate common name validation. Only enable this for development
                scenarios with self-signed certificates.
    endif
endmenu

menu "OTA"
    config UL_OTA_MANIFEST_URL
        string "Manifest URL"
        default "https://lights.evm100.org/firmware/UltraLights/<node-id>/latest.bin"
    config UL_OTA_BEARER_TOKEN
        string "Bearer token"
    config UL_OTA_HMAC_SECRET
        string "Manifest HMAC secret"
    config UL_OTA_ROLLBACK_ENABLE
        bool "Enable rollback"
        default y
    config UL_OTA_SERVER_HOST
        string "Override OTA server host/IP"
        default ""
        help
            If set, this host or IP is used instead of the one in UL_OTA_MANIFEST_URL.
            Useful when your router lacks NAT hairpinning and the firmware server is on the LAN.
    config UL_OTA_COMMON_NAME
        string "OTA server TLS common name"
        default "lights.evm100.org"
        help
            Expected common name in the TLS certificate of the OTA server.
endmenu

menu "Engine"
    config UL_WS2812_FPS
        int "WS2812 FPS"
        range 1 240
        default 60
    config UL_WHITE_SMOOTH_HZ
        int "White smoothing (Hz)"
        range 10 1000
        default 200
    config UL_RGB_SMOOTH_HZ
        int "RGB smoothing (Hz)"
        range 10 1000
        default 200
    config UL_GAMMA_ENABLE
        bool "Enable gamma correction"
        default y
endmenu

menu "Sensors"
    config UL_PIR_ENABLED
        bool "PIR enabled"
        default y
    config UL_PIR_GPIO
        int "PIR GPIO"
        default 25
    config UL_PIR_EVENT_MIN_INTERVAL_S
        int "PIR minimum publish interval (s)"
        range 1 600
        default 1

    config UL_PIR_POLL_MS
        int "PIR poll rate (ms)"
        range 100 10000
        default 1000

endmenu

menu "RGB Strips (LEDC)"
    menu "RGB 0"
        config UL_RGB0_ENABLED
            bool "Enabled"
            default n
        config UL_RGB0_PWM_HZ
            int "PWM Hz"
            default 1000
        config UL_RGB0_LEDC_MODE
            int "LEDC mode (0=low speed, 1=high speed)"
            range 0 1
            default 0
        config UL_RGB0_R_GPIO
            int "Red GPIO"
            default 16
        config UL_RGB0_R_LEDC_CH
            int "Red LEDC Channel"
            range 0 7
            default 4
        config UL_RGB0_G_GPIO
            int "Green GPIO"
            default 17
        config UL_RGB0_G_LEDC_CH
            int "Green LEDC Channel"
            range 0 7
            default 5
        config UL_RGB0_B_GPIO
            int "Blue GPIO"
            default 21
        config UL_RGB0_B_LEDC_CH
            int "Blue LEDC Channel"
            range 0 7
            default 6
    endmenu
    menu "RGB 1"
        config UL_RGB1_ENABLED
            bool "Enabled"
            default n
        config UL_RGB1_PWM_HZ
            int "PWM Hz"
            default 1000
        config UL_RGB1_LEDC_MODE
            int "LEDC mode (0=low speed, 1=high speed)"
            range 0 1
            default 0
        config UL_RGB1_R_GPIO
            int "Red GPIO"
            default 22
        config UL_RGB1_R_LEDC_CH
            int "Red LEDC Channel"
            range 0 7
            default 1
        config UL_RGB1_G_GPIO
            int "Green GPIO"
            default 23
        config UL_RGB1_G_LEDC_CH
            int "Green LEDC Channel"
            range 0 7
            default 2
        config UL_RGB1_B_GPIO
            int "Blue GPIO"
            default 19
        config UL_RGB1_B_LEDC_CH
            int "Blue LEDC Channel"
            range 0 7
            default 3
    endmenu
    menu "RGB 2"
        config UL_RGB2_ENABLED
            bool "Enabled"
            default n
        config UL_RGB2_PWM_HZ
            int "PWM Hz"
            default 1000
        config UL_RGB2_LEDC_MODE
            int "LEDC mode (0=low speed, 1=high speed)"
            range 0 1
            default 0
        config UL_RGB2_R_GPIO
            int "Red GPIO"
            default 25
        config UL_RGB2_R_LEDC_CH
            int "Red LEDC Channel"
            range 0 7
            default 4
        config UL_RGB2_G_GPIO
            int "Green GPIO"
            default 26
        config UL_RGB2_G_LEDC_CH
            int "Green LEDC Channel"
            range 0 7
            default 5
        config UL_RGB2_B_GPIO
            int "Blue GPIO"
            default 27
        config UL_RGB2_B_LEDC_CH
            int "Blue LEDC Channel"
            range 0 7
            default 6
    endmenu
    menu "RGB 3"
        config UL_RGB3_ENABLED
            bool "Enabled"
            default n
        config UL_RGB3_PWM_HZ
            int "PWM Hz"
            default 1000
        config UL_RGB3_LEDC_MODE
            int "LEDC mode (0=low speed, 1=high speed)"
            range 0 1
            default 0
        config UL_RGB3_R_GPIO
            int "Red GPIO"
            default 32
        config UL_RGB3_R_LEDC_CH
            int "Red LEDC Channel"
            range 0 7
            default 0
        config UL_RGB3_G_GPIO
            int "Green GPIO"
            default 33
        config UL_RGB3_G_LEDC_CH
            int "Green LEDC Channel"
            range 0 7
            default 1
        config UL_RGB3_B_GPIO
            int "Blue GPIO"
            default 27
        config UL_RGB3_B_LEDC_CH
            int "Blue LEDC Channel"
            range 0 7
            default 2
    endmenu
endmenu

menu "WS2812 Strips"
    menu "Strip 0"
        config UL_WS0_ENABLED
            bool "Enabled"
            default y
        config UL_WS0_GPIO
            int "GPIO"
            default 18
        config UL_WS0_PIXELS
            int "Pixel count"
            default 60
    endmenu
    menu "Strip 1"
        config UL_WS1_ENABLED
            bool "Enabled"
            default n
        config UL_WS1_GPIO
            int "GPIO"
            default 19
        config UL_WS1_PIXELS
            int "Pixel count"
            default 60
    endmenu
endmenu

menu "White Strips (LEDC)"
    menu "White 0"
        config UL_WHT0_ENABLED
            bool "Enabled"
            default y
        config UL_WHT0_GPIO
            int "GPIO"
            default 5
        config UL_WHT0_LEDC_CH
            int "LEDC Channel"
            range 0 7
            default 0
        config UL_WHT0_PWM_HZ
            int "PWM Hz"
            default 1000
        config UL_WHT0_MIN
            int "Min clamp"
            default 0
        config UL_WHT0_MAX
            int "Max clamp"
            default 255
    endmenu
    menu "White 1"
        config UL_WHT1_ENABLED
            bool "Enabled"
            default n
        config UL_WHT1_GPIO
            int "GPIO"
            default 4
        config UL_WHT1_LEDC_CH
            int "LEDC Channel"
            range 0 7
            default 1
        config UL_WHT1_PWM_HZ
            int "PWM Hz"
            default 1000
        config UL_WHT1_MIN
            int "Min clamp"
            default 0
        config UL_WHT1_MAX
            int "Max clamp"
            default 255
    endmenu
    menu "White 2"
        config UL_WHT2_ENABLED
            bool "Enabled"
            default n
        config UL_WHT2_GPIO
            int "GPIO"
            default 2
        config UL_WHT2_LEDC_CH
            int "LEDC Channel"
            range 0 7
            default 2
        config UL_WHT2_PWM_HZ
            int "PWM Hz"
            default 1000
        config UL_WHT2_MIN
            int "Min clamp"
            default 0
        config UL_WHT2_MAX
            int "Max clamp"
            default 255
    endmenu
    menu "White 3"
        config UL_WHT3_ENABLED
            bool "Enabled"
            default n
        config UL_WHT3_GPIO
            int "GPIO"
            default 15
        config UL_WHT3_LEDC_CH
            int "LEDC Channel"
            range 0 7
            default 3
        config UL_WHT3_PWM_HZ
            int "PWM Hz"
            default 1000
        config UL_WHT3_MIN
            int "Min clamp"
            default 0
        config UL_WHT3_MAX
            int "Max clamp"
            default 255
    endmenu
endmenu

endmenu
```

## UltraNodeV5/sdkconfig.defaults
```kconfig
# ---- System ----
CONFIG_UL_IS_ESP32C3=n

# ---- Node / Network ----
CONFIG_UL_NODE_ID="node01"
CONFIG_UL_WIFI_STATIC_CREDENTIALS=n
CONFIG_UL_WIFI_RESET_BUTTON_ENABLE=y
CONFIG_UL_WIFI_RESET_BUTTON_GPIO=0
CONFIG_UL_WIFI_RESET_BUTTON_HOLD_MS=5000
CONFIG_UL_WIFI_RESET_BUTTON_POLL_MS=50
CONFIG_UL_SNTP_SYNC_INTERVAL_S=21600

# ---- MQTT ----
CONFIG_UL_MQTT_URI="mqtts://lights.evm100.org:8883"
CONFIG_UL_MQTT_USER="uluser"
CONFIG_UL_MQTT_PASS="ulpwd"
CONFIG_UL_MQTT_DIAL_HOST=""
CONFIG_UL_MQTT_DIAL_PORT=0
CONFIG_UL_MQTT_USE_TLS=y
CONFIG_UL_MQTT_TLS_COMMON_NAME="lights.evm100.org"
CONFIG_UL_MQTT_TLS_SKIP_COMMON_NAME_CHECK=n

# ---- OTA ----
CONFIG_UL_OTA_MANIFEST_URL="https://lights.evm100.org/firmware/UltraLights/<node-id>/manifest"
CONFIG_UL_OTA_BEARER_TOKEN="changeme-token"
CONFIG_UL_OTA_HMAC_SECRET="changeme-hmac"
CONFIG_UL_OTA_ROLLBACK_ENABLE=y
CONFIG_UL_OTA_SERVER_HOST=""
CONFIG_UL_OTA_COMMON_NAME="lights.evm100.org"

# ---- Engine Defaults ----
CONFIG_UL_WS2812_FPS=60
CONFIG_UL_WHITE_SMOOTH_HZ=200
CONFIG_UL_RGB_SMOOTH_HZ=200
CONFIG_UL_GAMMA_ENABLE=y

# ---- Sensors ----
CONFIG_UL_PIR_ENABLED=y
CONFIG_UL_PIR_GPIO=25
CONFIG_UL_PIR_EVENT_MIN_INTERVAL_S=1
CONFIG_UL_PIR_POLL_MS=1000

# ---- Outputs (WS2812 strips 0..1) ----
CONFIG_UL_WS0_ENABLED=y
CONFIG_UL_WS0_GPIO=18
CONFIG_UL_WS0_PIXELS=60

CONFIG_UL_WS1_ENABLED=n
CONFIG_UL_WS1_GPIO=19
CONFIG_UL_WS1_PIXELS=60

# ---- White strips (LEDC 0..3) ----
CONFIG_UL_WHT0_ENABLED=y
CONFIG_UL_WHT0_GPIO=5
CONFIG_UL_WHT0_LEDC_CH=0
CONFIG_UL_WHT0_PWM_HZ=1000
CONFIG_UL_WHT0_MIN=0
CONFIG_UL_WHT0_MAX=255

CONFIG_UL_WHT1_ENABLED=n
CONFIG_UL_WHT1_GPIO=4
CONFIG_UL_WHT1_LEDC_CH=1
CONFIG_UL_WHT1_PWM_HZ=1000
CONFIG_UL_WHT1_MIN=0
CONFIG_UL_WHT1_MAX=255

CONFIG_UL_WHT2_ENABLED=n
CONFIG_UL_WHT2_GPIO=2
CONFIG_UL_WHT2_LEDC_CH=2
CONFIG_UL_WHT2_PWM_HZ=1000
CONFIG_UL_WHT2_MIN=0
CONFIG_UL_WHT2_MAX=255

CONFIG_UL_WHT3_ENABLED=n
CONFIG_UL_WHT3_GPIO=15
CONFIG_UL_WHT3_LEDC_CH=3
CONFIG_UL_WHT3_PWM_HZ=1000
CONFIG_UL_WHT3_MIN=0
CONFIG_UL_WHT3_MAX=255

# ---- RGB strips (LEDC) ----
CONFIG_UL_RGB0_ENABLED=n
CONFIG_UL_RGB0_PWM_HZ=1000
CONFIG_UL_RGB0_LEDC_MODE=0
CONFIG_UL_RGB0_R_GPIO=16
CONFIG_UL_RGB0_R_LEDC_CH=4
CONFIG_UL_RGB0_G_GPIO=17
CONFIG_UL_RGB0_G_LEDC_CH=5
CONFIG_UL_RGB0_B_GPIO=21
CONFIG_UL_RGB0_B_LEDC_CH=6

CONFIG_UL_RGB1_ENABLED=n
CONFIG_UL_RGB1_PWM_HZ=1000
CONFIG_UL_RGB1_LEDC_MODE=0
CONFIG_UL_RGB1_R_GPIO=22
CONFIG_UL_RGB1_R_LEDC_CH=1
CONFIG_UL_RGB1_G_GPIO=23
CONFIG_UL_RGB1_G_LEDC_CH=2
CONFIG_UL_RGB1_B_GPIO=19
CONFIG_UL_RGB1_B_LEDC_CH=3

CONFIG_UL_RGB2_ENABLED=n
CONFIG_UL_RGB2_PWM_HZ=1000
CONFIG_UL_RGB2_LEDC_MODE=0
CONFIG_UL_RGB2_R_GPIO=25
CONFIG_UL_RGB2_R_LEDC_CH=4
CONFIG_UL_RGB2_G_GPIO=26
CONFIG_UL_RGB2_G_LEDC_CH=5
CONFIG_UL_RGB2_B_GPIO=27
CONFIG_UL_RGB2_B_LEDC_CH=6

CONFIG_UL_RGB3_ENABLED=n
CONFIG_UL_RGB3_PWM_HZ=1000
CONFIG_UL_RGB3_LEDC_MODE=0
CONFIG_UL_RGB3_R_GPIO=32
CONFIG_UL_RGB3_R_LEDC_CH=0
CONFIG_UL_RGB3_G_GPIO=33
CONFIG_UL_RGB3_G_LEDC_CH=1
CONFIG_UL_RGB3_B_GPIO=27
CONFIG_UL_RGB3_B_LEDC_CH=2
```

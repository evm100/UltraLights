## firmware/components/ul_argb/Kconfig
```kconfig
menu "UltraLights: strip driver (ul_argb)"
    config UL_ARGB_ENABLE
        bool "Drive argb channels with RMT"
        default y
endmenu
```

## firmware/components/ul_board/Kconfig
```kconfig
menu "UltraLights: board descriptor (ul_board)"
    comment "Always built: every node reads its board descriptor from the ul_board partition."
    comment "Pin rules come from contracts/chips.json via tools/gen_chip_rules.py."
endmenu
```

## firmware/components/ul_contract/Kconfig
```kconfig
menu "UltraLights: contract codec (ul_contract)"
    comment "Always built: JSON encode/decode for contracts/schemas. No options."
endmenu
```

## firmware/components/ul_core/Kconfig
```kconfig
menu "UltraLights: device model (ul_core)"
    config UL_PROFILE
        string "Firmware profile name"
        default "dev"
        help
            Reported as `profile` in info and enrollment (c3-lights, c6-lights, ...).
            Set by the profile fragment in profiles/.
endmenu
```

## firmware/components/ul_health/Kconfig
```kconfig
menu "UltraLights: health metrics (ul_health)"
    comment "Always built: ul_mqtt publishes these every 60 s."
endmenu
```

## firmware/components/ul_identity/Kconfig
```kconfig
menu "UltraLights: identity and enrollment (ul_identity)"
    config UL_IDENTITY_ENABLE
        bool "On-chip key, HTTPS enrollment, certificate in NVS"
        default y
endmenu
```

## firmware/components/ul_mqtt/Kconfig
```kconfig
menu "UltraLights: MQTT (ul_mqtt)"
    config UL_MQTT_ENABLE
        bool "Connect to the broker with mutual TLS"
        default y
endmenu
```

## firmware/components/ul_ota/Kconfig
```kconfig
menu "UltraLights: OTA updates (ul_ota)"
    config UL_OTA_ENABLE
        bool "Accept OTA commands and confirm new images"
        default y
        help
            Without this component a new image is never marked valid, so with
            rollback enabled it would roll back on its next reset. Keep it on.
endmenu
```

## firmware/components/ul_provision/Kconfig
```kconfig
menu "UltraLights: setup page and reset button (ul_provision)"
    config UL_PROVISION_ENABLE
        bool "Setup access point, captive DNS and setup page"
        default y
endmenu
```

## firmware/components/ul_pwm/Kconfig
```kconfig
menu "UltraLights: PWM driver (ul_pwm)"
    config UL_PWM_ENABLE
        bool "Drive pwm channels with LEDC"
        default y
endmenu
```

## firmware/components/ul_servo/Kconfig
```kconfig
menu "UltraLights: servo button presser (ul_servo)"
    config UL_SERVO_ENABLE
        bool "Drive servo channels (press an appliance's own button)"
        default y
        help
            A servo channel presses a button: press angle, hold, back to the
            rest angle, settle. ul_core counts the presses for cycle outputs.

    config UL_SERVO_DETACH
        bool "Stop the servo signal between presses"
        depends on UL_SERVO_ENABLE
        default y
        help
            After each press settles, the signal stops, so the servo doesn't
            hum or jitter while it waits. Turn off for a servo that must hold
            its rest angle against a load.

    config UL_SERVO_MIN_US
        int "Pulse width for 0 degrees (us)"
        depends on UL_SERVO_ENABLE
        range 300 1500
        default 500

    config UL_SERVO_MAX_US
        int "Pulse width for 180 degrees (us)"
        depends on UL_SERVO_ENABLE
        range 1500 2700
        default 2500
endmenu
```

## firmware/components/ul_status/Kconfig
```kconfig
menu "UltraLights: status LED (ul_status)"
    config UL_STATUS_ENABLE
        bool "Blink the status LED"
        default y
endmenu
```

## firmware/components/ul_switch/Kconfig
```kconfig
menu "UltraLights: relay and solenoid driver (ul_switch)"
    config UL_SWITCH_ENABLE
        bool "Drive switch channels as GPIO outputs"
        default y
endmenu
```

## firmware/components/ul_wifi/Kconfig
```kconfig
menu "UltraLights: Wi-Fi (ul_wifi)"
    config UL_WIFI_ENABLE
        bool "Join Wi-Fi as a station"
        default y
        help
            Station with exponential backoff (1 s to 60 s), the DNS override
            from the setup page (re-applied after every lease and checked every
            30 s) and SNTP time sync.
endmenu
```

## firmware/test/qemu/sdkconfig.defaults
```kconfig
CONFIG_IDF_TARGET="esp32c3"
CONFIG_ESPTOOLPY_FLASHSIZE_4MB=y
CONFIG_MBEDTLS_X509_CREATE_C=y
CONFIG_MBEDTLS_X509_CSR_WRITE_C=y
CONFIG_MBEDTLS_PEM_WRITE_C=y
CONFIG_MBEDTLS_PK_WRITE_C=y
CONFIG_ESP_MAIN_TASK_STACK_SIZE=8192
CONFIG_UL_PROFILE="qemu-test"
```
